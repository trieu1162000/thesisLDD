/dts-v1/;
/plugin/;
/ {
	compatible = "brcm,bcm2835";
	fragment@0 {
		target = <&i2c1>;
		__overlay__ {
			#address-cells = <1>;
			#size-cells = <0>;

			lcd0: lcd_i2c1@27 {
				compatible = "lcd_i2c1";
				reg = <0x27>;
				status = "okay";
			};
		};
	};
};